## devices/greatlte/boot/image.its
```
/dts-v1/;

/*
 * The FIT image that barebox boots. S-Boot loads it as the ramdisk of the
 * boot image, at 0x89000000 (the stock tree's linux,initrd-start).
 */
/ {
	description = "Perpetua for the Samsung Galaxy Note 8";
	#address-cells = <1>;

	images {
		kernel {
			description = "Linux";
			data = /incbin/("Image.gz");
			type = "kernel";
			arch = "arm64";
			os = "linux";
			compression = "gzip";
			/* 2 MiB aligned, as the arm64 boot protocol asks. */
			load = <0x80200000>;
			entry = <0x80200000>;
		};

		fdt {
			description = "Samsung Galaxy Note 8";
			data = /incbin/("exynos8895-greatlte.dtb");
			type = "flat_dt";
			arch = "arm64";
			compression = "none";
		};

		ramdisk {
			description = "Rescue initramfs";
			data = /incbin/("initramfs.cpio.gz");
			type = "ramdisk";
			arch = "arm64";
			os = "linux";
			compression = "none";
		};
	};

	configurations {
		default = "greatlte";

		greatlte {
			description = "Samsung Galaxy Note 8";
			kernel = "kernel";
			fdt = "fdt";
			ramdisk = "ramdisk";
		};
	};
};
```
